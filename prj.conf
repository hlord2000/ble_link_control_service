## CMakeLists.txt
```
# SPDX-License-Identifier: Apache-2.0

cmake_minimum_required(VERSION 3.20.0)

find_package(Zephyr REQUIRED HINTS $ENV{ZEPHYR_BASE})
project(link_control)

target_sources(app PRIVATE 
	src/link_control/link_control.c
)

target_sources_ifdef(CONFIG_BT_PERIPHERAL app PRIVATE 
	src/peripheral.c
	src/link_control/link_control_service.c
)
target_sources_ifdef(CONFIG_BT_CENTRAL app PRIVATE src/central.c)

include_directories(include)
```

## Kconfig
```
config BT_NUS_THREAD_STACK_SIZE
	int "Thread stack size"
	default 1024
	help
	  Stack size used in each of the two threads

source "Kconfig.zephyr"
```

## prj.conf
```kconfig
CONFIG_GPIO=y

# Make sure printk is printing to the UART console
CONFIG_CONSOLE=y

CONFIG_HEAP_MEM_POOL_SIZE=2048

CONFIG_BT=y

CONFIG_BT_CTLR_PHY_CODED=y
CONFIG_BT_CTLR_PHY_2M=y
CONFIG_BT_CTLR_ADV_EXT=y
CONFIG_BT_EXT_ADV=y
CONFIG_BT_USER_PHY_UPDATE=y
CONFIG_BT_DEVICE_NAME="Link Control Service"
CONFIG_BT_MAX_CONN=1
CONFIG_BT_MAX_PAIRED=1
CONFIG_BT_GATT_CLIENT=y
CONFIG_BT_GATT_DM=y

CONFIG_BT_DEBUG_LOG=y
CONFIG_BT_LOG_SNIFFER_INFO=y
CONFIG_BT_USE_DEBUG_KEYS=y

# Enable bonding
CONFIG_BT_SETTINGS=y
CONFIG_FLASH=y
CONFIG_FLASH_PAGE_LAYOUT=y
CONFIG_FLASH_MAP=y
CONFIG_NVS=y
CONFIG_SETTINGS=y

# This example requires more stack
CONFIG_MAIN_STACK_SIZE=1152
CONFIG_SYSTEM_WORKQUEUE_STACK_SIZE=2048

# Config logger
CONFIG_LOG=y
CONFIG_LOG_MODE_IMMEDIATE=y

# Enable RSSI and TX power control
CONFIG_BT_CTLR_CONN_RSSI=y
CONFIG_BT_CTLR_TX_PWR_DYNAMIC_CONTROL=y

CONFIG_SHELL=y

CONFIG_BT_CTLR_TX_PWR_PLUS_8=y
```

## central.conf
```kconfig
CONFIG_BT_CENTRAL=y
```

## peripheral.conf
```kconfig
CONFIG_BT_PERIPHERAL=y
CONFIG_BT_CTLR_TX_PWR_PLUS_10=y
```

## src/main.c
```c
#include <zephyr/types.h>
#include <zephyr/kernel.h>
#include <zephyr/drivers/uart.h>

#include <zephyr/bluetooth/bluetooth.h>
#include <zephyr/bluetooth/conn.h>
#include <zephyr/bluetooth/uuid.h>
#include <zephyr/bluetooth/gatt.h>
#include <zephyr/bluetooth/hci.h>
#include <zephyr/bluetooth/hci_vs.h>

#include <bluetooth/services/nus.h>

#include <zephyr/settings/settings.h>

#include <stdio.h>
#include <string.h>

#include <zephyr/logging/log.h>

#include "rssi.h"
#include "tx_power.h"

#define LOG_MODULE_NAME peripheral_uart
LOG_MODULE_REGISTER(LOG_MODULE_NAME);

#define STACKSIZE CONFIG_BT_NUS_THREAD_STACK_SIZE
#define PRIORITY 7

#define DEVICE_NAME CONFIG_BT_DEVICE_NAME
#define DEVICE_NAME_LEN	(sizeof(DEVICE_NAME) - 1)

static K_SEM_DEFINE(ble_init_ok, 0, 1);

static struct bt_conn *current_conn;
static struct bt_conn *auth_conn;

static const struct bt_data ad[] = {
	BT_DATA_BYTES(BT_DATA_FLAGS, (BT_LE_AD_GENERAL | BT_LE_AD_NO_BREDR)),
	BT_DATA(BT_DATA_NAME_COMPLETE, DEVICE_NAME, DEVICE_NAME_LEN),
};

static const struct bt_data sd[] = {
	BT_DATA_BYTES(BT_DATA_UUID128_ALL, BT_UUID_NUS_VAL),
};

static void connected(struct bt_conn *conn, uint8_t err)
{
	char addr[BT_ADDR_LE_STR_LEN];

	if (err) {
		LOG_ERR("Connection failed (err %u)", err);
		return;
	}

	bt_addr_le_to_str(bt_conn_get_dst(conn), addr, sizeof(addr));
	LOG_INF("Connected %s", addr);

	current_conn = bt_conn_ref(conn);
	set_tx_power(BT_HCI_VS_LL_HANDLE_TYPE_CONN, 0, 8);
}

static void disconnected(struct bt_conn *conn, uint8_t reason)
{
	char addr[BT_ADDR_LE_STR_LEN];

	bt_addr_le_to_str(bt_conn_get_dst(conn), addr, sizeof(addr));

	LOG_INF("Disconnected: %s (reason %u)", addr, reason);

	if (auth_conn) {
		bt_conn_unref(auth_conn);
		auth_conn = NULL;
	}

	if (current_conn) {
		bt_conn_unref(current_conn);
		current_conn = NULL;
	}
}

BT_CONN_CB_DEFINE(conn_callbacks) = {
	.connected    = connected,
	.disconnected = disconnected,
};

static void bt_receive_cb(struct bt_conn *conn, const uint8_t *const data,
			  uint16_t len)
{
	char addr[BT_ADDR_LE_STR_LEN] = {0};

	bt_addr_le_to_str(bt_conn_get_dst(conn), addr, ARRAY_SIZE(addr));

	LOG_INF("Received data from: %s", addr);
}

static struct bt_nus_cb nus_cb = {
	.received = bt_receive_cb,
};

int main(void)
{
	int err = 0;

	err = bt_enable(NULL);
	if (err) {
		LOG_ERR("Bluetooth init failed (err %d)", err);
		return 0;
	}

	LOG_INF("Bluetooth initialized");

	k_sem_give(&ble_init_ok);

	if (IS_ENABLED(CONFIG_SETTINGS)) {
		settings_load();
	}

	set_tx_power(BT_HCI_VS_LL_HANDLE_TYPE_ADV, 0, 8);

	err = bt_nus_init(&nus_cb);
	if (err) {
		LOG_ERR("Failed to initialize UART service (err: %d)", err);
		return 0;
	}

	err = bt_le_adv_start(BT_LE_ADV_CONN, ad, ARRAY_SIZE(ad), sd,
			      ARRAY_SIZE(sd));
	if (err) {
		LOG_ERR("Advertising failed to start (err %d)", err);
		return 0;
	}
}

void ble_write_thread(void)
{
	int err;

	/* Don't go any further until BLE is initialized */
	k_sem_take(&ble_init_ok, K_FOREVER);

	uint8_t data[16];
	uint16_t len = sizeof(data);
	int8_t rssi;

	while (true) {
		err = read_conn_rssi(NULL, &rssi);
		snprintf(data, sizeof(data), "RSSI: %d", rssi);

		err = bt_nus_send(NULL, data, len);
		if (err < 0) {
			LOG_ERR("Failed to send data over BLE connection: %d", err);
		}
		k_msleep(100);
	}
}

K_THREAD_DEFINE(ble_write_thread_id, STACKSIZE, ble_write_thread, NULL, NULL,
		NULL, PRIORITY, 0, 0);
```

## include/link_control.h
```c
#ifndef LINK_CONTROL_H__
#define LINK_CONTROL_H__

#include <stdint.h>
#include <zephyr/bluetooth/bluetooth.h>

// Set the TX power level for a connection
int set_tx_power(uint8_t handle_type, uint16_t handle, int8_t tx_pwr_lvl);

// Read connection RSSI
int read_conn_rssi(uint16_t handle, int8_t *rssi);

// Change the connection interval
int change_connection_interval(struct bt_conn *conn, uint16_t interval_us);

// Update the connection PHY
int update_phy(struct bt_conn *conn, uint8_t phy);

#endif
```

## include/link_control_service.h
```c
#ifndef LINK_CONTROL_SERVICE_H__
#define LINK_CONTROL_SERVICE_H__

#include <zephyr/types.h>
#include <zephyr/bluetooth/conn.h>
#include <zephyr/bluetooth/uuid.h>
#include <zephyr/bluetooth/gatt.h>

#define BT_UUID_LCS_VAL \
    BT_UUID_128_ENCODE(0x430EBAD0, 0x5C25, 0x469E, 0xA162, 0xA1C9DC50A8FD)
#define BT_UUID_LCS_TX_PWR_VAL \
    BT_UUID_128_ENCODE(0x430EBAD1, 0x5C25, 0x469E, 0xA162, 0xA1C9DC50A8FD)
#define BT_UUID_LCS           BT_UUID_DECLARE_128(BT_UUID_LCS_VAL)
#define BT_UUID_LCS_TX_PWR    BT_UUID_DECLARE_128(BT_UUID_LCS_TX_PWR_VAL)

#endif
```

## include/rssi.h
```c
#ifndef RSSI_H__
#define RSSI_H__
#include <stdint.h>

int read_conn_rssi(uint16_t handle, int8_t *rssi);

#endif
```

## include/tx_power.h
```c
#ifndef TX_POWER_H__
#define TX_POWER_H__

#include <stdint.h>
int set_tx_power(uint8_t handle_type, uint16_t handle, int8_t tx_pwr_lvl);

#endif
```

## src/central.c
```c
#include <zephyr/types.h>
#include <stdlib.h>
#include <stddef.h>
#include <zephyr/kernel.h>
#include <zephyr/bluetooth/bluetooth.h>
#include <zephyr/bluetooth/hci.h>
#include <zephyr/bluetooth/conn.h>
#include <zephyr/bluetooth/uuid.h>
#include <zephyr/bluetooth/gatt.h>
#include <zephyr/bluetooth/hci_vs.h>
#include <zephyr/sys/byteorder.h>
#include <zephyr/settings/settings.h>
#include <zephyr/logging/log.h>
#include <zephyr/shell/shell.h>
#include "link_control.h"
#include "link_control_service.h"

LOG_MODULE_REGISTER(link_control_central);

#define RSSI_LOG_RATE_MS 500

struct rssi_reading {
	int8_t rssi;
	uint32_t timestamp;
};

struct rssi_reading rssi_buf[1024];

K_MUTEX_DEFINE(lcs_conn_mutex);

static void start_scan(void);
static struct bt_uuid_128 discover_uuid = BT_UUID_INIT_128(0);
static struct bt_conn *default_conn;
static uint16_t tx_power_handle;
#define NAME_LEN 256

struct link_control_handles {
    uint16_t tx_power_handle;
    // Add other characteristic handles as needed
};

static struct link_control_handles lc_handles;

static bool data_cb(struct bt_data *data, void *user_data) {
    int err;
    struct bt_uuid *uuid = user_data;
    switch (data->type) {
    case BT_DATA_UUID128_SOME:
    case BT_DATA_UUID128_ALL:
        err = bt_uuid_create(uuid, data->data, data->data_len);
        if (err < 0) {
            uuid = NULL;
            LOG_ERR("Unable to parse UUID from advertisement data");
            return false;
        }
        return true;
    default:
        return true;
    }
}

static void device_found(const bt_addr_le_t *addr, int8_t rssi, uint8_t type,
             struct net_buf_simple *ad)
{
    char addr_str[BT_ADDR_LE_STR_LEN];
    struct bt_uuid service_uuid;
    int err;

    if (default_conn) {
        return;
    }

    if (type != BT_GAP_ADV_TYPE_ADV_IND &&
        type != BT_GAP_ADV_TYPE_ADV_DIRECT_IND &&
        type != BT_GAP_ADV_TYPE_SCAN_RSP) {
        return;
    }

    bt_addr_le_to_str(addr, addr_str, sizeof(addr_str));
    bt_data_parse(ad, data_cb, &service_uuid);

    if (!bt_uuid_cmp(&service_uuid, BT_UUID_LCS)) {
        char uuid_str[NAME_LEN];
        bt_uuid_to_str(&service_uuid, uuid_str, sizeof(uuid_str));
        LOG_INF("Found service: %s", uuid_str);

        err = bt_le_scan_stop();
        if (err) {
            LOG_ERR("Stop LE scan failed (err %d)", err);
            return;
        }



        err = bt_conn_le_create(addr, BT_CONN_LE_CREATE_CONN,
                    BT_LE_CONN_PARAM(400, 600, 0, 1500), 
					&default_conn);
        if (err < 0) {
            LOG_ERR("Create conn to %s failed (%d)", addr_str, err);
            start_scan();
        } else {
            LOG_INF("Connection initiated to %s", addr_str);
        }
    }
}

static void start_scan(void)
{
    int err;
    err = bt_le_scan_start(BT_LE_SCAN_ACTIVE, device_found);
    if (err < 0) {
        LOG_ERR("Scanning failed to start (err %d)", err);
        return;
    }
    LOG_INF("Scanning successfully started");
}

static struct bt_gatt_discover_params discover_params;
static struct bt_gatt_write_params write_params;

static void write_func(struct bt_conn *conn, uint8_t err,
                       struct bt_gatt_write_params *params)
{
    if (err) {
        LOG_ERR("Write failed (err %u)", err);
    } else {
        LOG_INF("Write successful");
    }
}

static void write_tx_power(struct bt_conn *conn, int8_t tx_power_value)
{
    int err;

    write_params.data = &tx_power_value;
    write_params.length = sizeof(tx_power_value);
    write_params.handle = tx_power_handle;
    write_params.offset = 0;
    write_params.func = write_func;

    err = bt_gatt_write(conn, &write_params);
    if (err) {
        LOG_ERR("Write failed (err %d)", err);
    }
}

static uint8_t discover_func(struct bt_conn *conn,
                             const struct bt_gatt_attr *attr,
                             struct bt_gatt_discover_params *params)
{
    int err;

    if (!attr) {
        LOG_INF("Discover complete");
        (void)memset(params, 0, sizeof(*params));
        return BT_GATT_ITER_STOP;
    }

    LOG_INF("[ATTRIBUTE] handle %u", attr->handle);

	char str[BT_UUID_STR_LEN];

	bt_uuid_to_str(attr->uuid, str, sizeof(str));
	LOG_INF("UUID: %s", str);

    if (bt_uuid_cmp(discover_params.uuid, BT_UUID_LCS) == 0) {
        // Service discovered, now discover characteristics
		memcpy(&discover_uuid, BT_UUID_LCS_TX_PWR, sizeof(discover_uuid));
		discover_params.uuid = &discover_uuid.uuid;
        discover_params.start_handle = attr->handle + 1;
        discover_params.type = BT_GATT_DISCOVER_CHARACTERISTIC;

        err = bt_gatt_discover(conn, &discover_params);
        if (err) {
            LOG_ERR("Discover failed (err %d)", err);
        }
    } else if (bt_uuid_cmp(discover_params.uuid, BT_UUID_LCS_TX_PWR) == 0) {
        // TX Power characteristic found
        tx_power_handle = bt_gatt_attr_value_handle(attr);
        LOG_INF("TX Power characteristic handle: %u", tx_power_handle);
    }

    return BT_GATT_ITER_STOP;
}

static void connected(struct bt_conn *conn, uint8_t err)
{
    char addr[BT_ADDR_LE_STR_LEN];
    bt_addr_le_to_str(bt_conn_get_dst(conn), addr, sizeof(addr));

    if (err < 0) {
        LOG_ERR("Failed to connect to %s (%u)", addr, err);
        bt_conn_unref(default_conn);
        default_conn = NULL;
        start_scan();
        return;
    }

    if (conn != default_conn) {
        return;
    }

	uint16_t conn_handle;

    err = bt_hci_get_conn_handle(default_conn, &conn_handle);
    if (err) {
		LOG_ERR("Failed to get connection handle (err %d)", err);
    }

    err = set_tx_power(BT_HCI_VS_LL_HANDLE_TYPE_CONN, conn_handle, 20);
    if (err) {
		LOG_ERR("Failed to set central connection TX power (err %d)", err);
    }

    LOG_INF("Connected: %s", addr);
	memcpy(&discover_uuid, BT_UUID_LCS, sizeof(discover_uuid));
	discover_params.uuid = &discover_uuid.uuid;
    discover_params.func = discover_func;
    discover_params.start_handle = BT_ATT_FIRST_ATTRIBUTE_HANDLE;
    discover_params.end_handle = BT_ATT_LAST_ATTRIBUTE_HANDLE;
    discover_params.type = BT_GATT_DISCOVER_PRIMARY;

    err = bt_gatt_discover(conn, &discover_params);
    if (err) {
        LOG_ERR("Discover failed(err %d)", err);
    }


}

static void disconnected(struct bt_conn *conn, uint8_t reason)
{
    char addr[BT_ADDR_LE_STR_LEN];

    if (conn != default_conn) {
        return;
    }

    bt_addr_le_to_str(bt_conn_get_dst(conn), addr, sizeof(addr));
    LOG_INF("Disconnected: %s (reason 0x%02x)", addr, reason);

    bt_conn_unref(default_conn);
    default_conn = NULL;

    start_scan();
}

static void le_phy_updated(struct bt_conn *conn,
               struct bt_conn_le_phy_info *param)
{
    char addr[BT_ADDR_LE_STR_LEN];

    bt_addr_le_to_str(bt_conn_get_dst(conn), addr, sizeof(addr));

    LOG_INF("LE PHY Updated: %s Tx 0x%x, Rx 0x%x", addr, param->tx_phy,
           param->rx_phy);
}

BT_CONN_CB_DEFINE(conn_callbacks) = {
    .connected = connected,
    .disconnected = disconnected,
    .le_phy_updated = le_phy_updated,
};

static int cmd_set_peripheral_tx(const struct shell *shell, size_t argc, char **argv)
{
    int8_t tx_power;
    if (argc != 2) {
        shell_error(shell, "Usage: set_peripheral_tx <power_level>");
        return -EINVAL;
    }
    tx_power = (int8_t)atoi(argv[1]);
    if (!default_conn) {
        shell_error(shell, "No active connection");
    }
    write_tx_power(default_conn, tx_power);
    return 0;
}

static int cmd_set_central_tx(const struct shell *shell, size_t argc, char **argv)
{
    int8_t tx_power;
    int err;
    uint16_t conn_handle;
    if (argc != 2) {
        shell_error(shell, "Usage: set_central_tx <power_level>");
        return -EINVAL;
    }
    tx_power = (int8_t)atoi(argv[1]);
    if (!default_conn) {
        shell_error(shell, "No active connection");
    }
    err = bt_hci_get_conn_handle(default_conn, &conn_handle);
    if (err) {
        shell_error(shell, "Failed to get connection handle (err %d)", err);
    }

    err = set_tx_power(BT_HCI_VS_LL_HANDLE_TYPE_CONN, conn_handle, tx_power);
    if (err) {
        shell_error(shell, "Failed to set central connection TX power (err %d)", err);
    }

    err = set_tx_power(BT_HCI_VS_LL_HANDLE_TYPE_SCAN, 0, tx_power);
    if (err) {
        shell_error(shell, "Failed to set central scan TX power (err %d)", err);
    }
    shell_print(shell, "Central TX power set to %d", tx_power);
    return 0;
}

static int cmd_set_phy(const struct shell *shell, size_t argc, char **argv)
{
    int err;
    uint8_t phy;
    if (argc != 2) {
        shell_error(shell, "Usage: set_phy <1m|2m|coded>");
        return -EINVAL;
    }
    if (!default_conn) {
        shell_error(shell, "No active connection");
        return -ENOEXEC;
    }
    if (strcmp(argv[1], "1m") == 0) {
        phy = BT_GAP_LE_PHY_1M;
    } else if (strcmp(argv[1], "2m") == 0) {
        phy = BT_GAP_LE_PHY_2M;
    } else if (strcmp(argv[1], "coded") == 0) {
        phy = BT_GAP_LE_PHY_CODED;
    } else {
        shell_error(shell, "Invalid PHY option. Use 1m, 2m, or coded.");
        return -EINVAL;
    }
    err = update_phy(default_conn, phy);
    if (err) {
        shell_error(shell, "Failed to update PHY (err %d)", err);
        return err;
    }
    shell_print(shell, "PHY update initiated to %s", argv[1]);
    return 0;
}

static int cmd_print_rssi_buf(const struct shell *shell, size_t argc, char **argv)
{
	for (int i = 0; i < 1024; i++) {
		if (rssi_buf[i].timestamp == 0) {
			break;
		}
		shell_print(shell, "RSSI: %d, Timestamp: %u", rssi_buf[i].rssi, rssi_buf[i].timestamp);
	}
	return 0;
}

uint32_t delay_ms;
static int cmd_capture_rssi(const struct shell *shell, size_t argc, char **argv) {

	if (argc != 2) {
		shell_error(shell, "Usage: capture_rssi <delay_ms>");
		return -EINVAL;
	}

	delay_ms = atoi(argv[1]);
	if (delay_ms < 0) {
		shell_error(shell, "Invalid delay value");
		return -EINVAL;
	}

	shell_print(shell, "Capturing RSSI in %d ms, please wait...", delay_ms);

	k_mutex_unlock(&lcs_conn_mutex);
	return 0;
}


SHELL_STATIC_SUBCMD_SET_CREATE(link_control_cmds,
    SHELL_CMD(set_peripheral_tx, NULL, "Set peripheral TX power", cmd_set_peripheral_tx),
    SHELL_CMD(set_central_tx, NULL, "Set central TX power", cmd_set_central_tx),
    SHELL_CMD(set_phy, NULL, "Set PHY (1m, 2m, or coded)", cmd_set_phy),
	SHELL_CMD(print_rssi_buf, NULL, "Print RSSI buffer", cmd_print_rssi_buf),
	SHELL_CMD(capture_rssi_delay, NULL, "Capture RSSI", cmd_capture_rssi),
    SHELL_SUBCMD_SET_END
);

SHELL_CMD_REGISTER(link_control, &link_control_cmds, "Link Control commands", NULL);

int main(void)
{
    int err;
	k_mutex_init(&lcs_conn_mutex);
	k_mutex_unlock(&lcs_conn_mutex);

    err = bt_enable(NULL);
    if (err < 0) {
        LOG_ERR("Bluetooth init failed (err %d)", err);
        return 0;
    }

    if (IS_ENABLED(CONFIG_SETTINGS)) {
        settings_load();
    }

    LOG_INF("Bluetooth initialized");
    start_scan();

    err = set_tx_power(BT_HCI_VS_LL_HANDLE_TYPE_SCAN, 0, 20);
    if (err) {
        LOG_ERR("Failed to set central scan TX power (err %d)", err);
    }

	LOG_INF("Waiting for connection");
	k_msleep(30000);

	uint16_t handle;
	bt_hci_get_conn_handle(default_conn, &handle);

	LOG_INF("Connection handle: %u", handle);
	for (int i = 0; i < 1024; i++) {
		read_conn_rssi(handle, &rssi_buf[i].rssi);
		rssi_buf[i].timestamp = k_uptime_get_32();
		LOG_INF("RSSI: %d, Timestamp: %u", rssi_buf[i].rssi, rssi_buf[i].timestamp);
		k_msleep(RSSI_LOG_RATE_MS);
	}

    return 0;
}
```

## src/lc_service.c
```c
#define BT_UUID_LCS_VAL \
	BT_UUID_128_ENCODE(0x430EBAD0, 0x5C25, 0x469E, 0xA162, 0xA1C9DC50A8FD)

#define BT_UUID_LCS_

TODO:
bt_conn_le_phy_update
```

## src/peripheral.c
```c
#include <zephyr/types.h>
#include <zephyr/kernel.h>
#include <zephyr/drivers/uart.h>

#include <zephyr/bluetooth/bluetooth.h>
#include <zephyr/bluetooth/conn.h>
#include <zephyr/bluetooth/uuid.h>
#include <zephyr/bluetooth/gatt.h>
#include <zephyr/bluetooth/hci.h>
#include <zephyr/bluetooth/hci_vs.h>

#include <zephyr/settings/settings.h>

#include <stdio.h>
#include <string.h>

#include <zephyr/logging/log.h>

#include "link_control.h"
#include "link_control_service.h"

LOG_MODULE_REGISTER(link_control_peripheral);

#define DEVICE_NAME CONFIG_BT_DEVICE_NAME
#define DEVICE_NAME_LEN	(sizeof(DEVICE_NAME) - 1)

static K_SEM_DEFINE(ble_init_ok, 0, 1);

static struct bt_conn *current_conn;

static const struct bt_data ad[] = {
	BT_DATA_BYTES(BT_DATA_FLAGS, (BT_LE_AD_GENERAL | BT_LE_AD_NO_BREDR)),
	BT_DATA(BT_DATA_NAME_COMPLETE, DEVICE_NAME, DEVICE_NAME_LEN),
};

static const struct bt_data sd[] = {
	BT_DATA_BYTES(BT_DATA_UUID128_ALL, BT_UUID_LCS_VAL),
};

int8_t tx_power_value = 20;

static void connected(struct bt_conn *conn, uint8_t err)
{
	char addr[BT_ADDR_LE_STR_LEN];

	if (err) {
		LOG_ERR("Connection failed (err %u)", err);
		return;
	}

	bt_addr_le_to_str(bt_conn_get_dst(conn), addr, sizeof(addr));
	LOG_INF("Connected %s", addr);

	current_conn = bt_conn_ref(conn);
	uint16_t conn_handle;
	bt_hci_get_conn_handle(current_conn, &conn_handle);
	set_tx_power(BT_HCI_VS_LL_HANDLE_TYPE_CONN, conn_handle, tx_power_value);
}

static void disconnected(struct bt_conn *conn, uint8_t reason)
{
	char addr[BT_ADDR_LE_STR_LEN];

	bt_addr_le_to_str(bt_conn_get_dst(conn), addr, sizeof(addr));

	LOG_INF("Disconnected: %s (reason %u)", addr, reason);

	if (current_conn) {
		bt_conn_unref(current_conn);
		current_conn = NULL;
	}
}

static void le_phy_updated(struct bt_conn *conn,
			   struct bt_conn_le_phy_info *param)
{
	char addr[BT_ADDR_LE_STR_LEN];

	bt_addr_le_to_str(bt_conn_get_dst(conn), addr, sizeof(addr));

	LOG_INF("LE PHY Updated: %s Tx 0x%x, Rx 0x%x", addr, param->tx_phy,
	       param->rx_phy);
}

BT_CONN_CB_DEFINE(conn_callbacks) = {
	.connected    = connected,
	.disconnected = disconnected,
	.le_phy_updated = le_phy_updated,
};

static void bt_receive_cb(struct bt_conn *conn, const uint8_t *const data,
			  uint16_t len)
{
	char addr[BT_ADDR_LE_STR_LEN] = {0};

	bt_addr_le_to_str(bt_conn_get_dst(conn), addr, ARRAY_SIZE(addr));

	LOG_INF("Received data from: %s", addr);
}

int main(void)
{
	int err = 0;

	err = bt_enable(NULL);
	if (err) {
		LOG_ERR("Bluetooth init failed (err %d)", err);
		return 0;
	}

	LOG_INF("Bluetooth initialized");

	k_sem_give(&ble_init_ok);

	if (IS_ENABLED(CONFIG_SETTINGS)) {
		settings_load();
	}

	err = bt_le_adv_start(BT_LE_ADV_CONN, ad, ARRAY_SIZE(ad), sd,
			      ARRAY_SIZE(sd));
	if (err) {
		LOG_ERR("Advertising failed to start (err %d)", err);
		return 0;
	}
	set_tx_power(BT_HCI_VS_LL_HANDLE_TYPE_ADV, 0, tx_power_value);
}

void ble_write_thread(void)
{
	int err;

	/* Don't go any further until BLE is initialized */
	k_sem_take(&ble_init_ok, K_FOREVER);

	uint8_t data[16];
	uint16_t len = sizeof(data);
	int8_t rssi;
/*
	while (true) {
		err = read_conn_rssi(NULL, &rssi);
		snprintf(data, sizeof(data), "RSSI: %d", rssi);

		k_msleep(100);
	}
*/
}

#define STACKSIZE 1024 
#define PRIORITY 7

K_THREAD_DEFINE(ble_write_thread_id, STACKSIZE, ble_write_thread, NULL, NULL,
		NULL, PRIORITY, 0, 0);
```

## src/rssi.c
```c
#include <zephyr/kernel.h>
#include <zephyr/sys/byteorder.h>
#include <zephyr/logging/log.h>

#include <zephyr/bluetooth/bluetooth.h>
#include <zephyr/bluetooth/hci.h>
#include <zephyr/bluetooth/hci_vs.h>

LOG_MODULE_REGISTER(rssi, LOG_LEVEL_DBG);

int read_conn_rssi(uint16_t handle, int8_t *rssi)
{
	struct net_buf *buf, *rsp = NULL;
	struct bt_hci_cp_read_rssi *cp;
	struct bt_hci_rp_read_rssi *rp;

	int err;

	buf = bt_hci_cmd_create(BT_HCI_OP_READ_RSSI, sizeof(*cp));
	if (!buf) {
		LOG_ERR("Unable to allocate command buffer");
		return -ENOMEM;
	}

	cp = net_buf_add(buf, sizeof(*cp));
	cp->handle = sys_cpu_to_le16(handle);

	err = bt_hci_cmd_send_sync(BT_HCI_OP_READ_RSSI, buf, &rsp);
	if (err < 0) {
		uint8_t reason = rsp ?
			((struct bt_hci_rp_read_rssi *)rsp->data)->status : 0;
		LOG_ERR("Read RSSI err: %d reason 0x%02x", err, reason);
		return err;
	}

	rp = (void *)rsp->data;
	*rssi = rp->rssi;

	net_buf_unref(rsp);
	return 0;
}
```

## src/tx_power.c
```c
#include <zephyr/kernel.h>
#include <zephyr/sys/byteorder.h>
#include <zephyr/logging/log.h>
#include <zephyr/bluetooth/bluetooth.h>
#include <zephyr/bluetooth/hci.h>
#include <zephyr/bluetooth/hci_vs.h>

LOG_MODULE_REGISTER(tx_power, LOG_LEVEL_DBG);

int set_tx_power(uint8_t handle_type, uint16_t handle, int8_t tx_pwr_lvl) {
	struct bt_hci_cp_vs_write_tx_power_level *cp;
	struct bt_hci_rp_vs_write_tx_power_level *rp;
	struct net_buf *buf, *rsp = NULL;
	int err;

	buf = bt_hci_cmd_create(BT_HCI_OP_VS_WRITE_TX_POWER_LEVEL,
				sizeof(*cp));
	if (!buf) {
		LOG_ERR("Unable to allocate command buffer");
		return -ENOMEM;
	}

	cp = net_buf_add(buf, sizeof(*cp));
	cp->handle = sys_cpu_to_le16(handle);
	cp->handle_type = handle_type;
	cp->tx_power_level = tx_pwr_lvl;

	err = bt_hci_cmd_send_sync(BT_HCI_OP_VS_WRITE_TX_POWER_LEVEL,
				   buf, &rsp);
	if (err < 0) {
		uint8_t reason = rsp ?
			((struct bt_hci_rp_vs_write_tx_power_level *)
			  rsp->data)->status : 0;
		LOG_ERR("Set Tx power err: %d reason 0x%02x", err, reason);
		return err;
	}

	rp = (void *)rsp->data;
	LOG_INF("Actual Tx Power: %d", rp->selected_tx_power);

	net_buf_unref(rsp);
	return 0;
}
```
