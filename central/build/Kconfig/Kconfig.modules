## central/build/Kconfig/Kconfig.modules
```kconfig
menu "nrf (/opt/ncs/ncs-v2.7/nrf)"
osource "/opt/ncs/ncs-v2.7/nrf/Kconfig.nrf"
config ZEPHYR_NRF_MODULE
	bool
	default y
endmenu
menu "mcuboot (/opt/ncs/ncs-v2.7/bootloader/mcuboot)"
osource "$(ZEPHYR_MCUBOOT_KCONFIG)"
config ZEPHYR_MCUBOOT_MODULE
	bool
	default y
endmenu
menu "mbedtls (/opt/ncs/ncs-v2.7/modules/crypto/mbedtls)"
osource "$(ZEPHYR_MBEDTLS_KCONFIG)"
config ZEPHYR_MBEDTLS_MODULE
	bool
	default y
endmenu
menu "oberon-psa-crypto (/opt/ncs/ncs-v2.7/modules/crypto/oberon-psa-crypto)"
osource "/opt/ncs/ncs-v2.7/modules/crypto/oberon-psa-crypto/Kconfig.oberon_psa_crypto"
config ZEPHYR_OBERON_PSA_CRYPTO_MODULE
	bool
	default y
endmenu
menu "trusted-firmware-m (/opt/ncs/ncs-v2.7/modules/tee/tf-m/trusted-firmware-m)"
osource "$(ZEPHYR_TRUSTED_FIRMWARE_M_KCONFIG)"
config ZEPHYR_TRUSTED_FIRMWARE_M_MODULE
	bool
	default y
endmenu
config ZEPHYR_PSA_ARCH_TESTS_MODULE
   bool
   default y
config ZEPHYR_SOC_HWMV1_MODULE
   bool
   default y
menu "cjson (/opt/ncs/ncs-v2.7/modules/lib/cjson)"
osource "$(ZEPHYR_CJSON_KCONFIG)"
config ZEPHYR_CJSON_MODULE
	bool
	default y
endmenu
menu "azure-sdk-for-c (/opt/ncs/ncs-v2.7/modules/lib/azure-sdk-for-c)"
osource "$(ZEPHYR_AZURE_SDK_FOR_C_KCONFIG)"
config ZEPHYR_AZURE_SDK_FOR_C_MODULE
	bool
	default y
endmenu
menu "cirrus-logic (/opt/ncs/ncs-v2.7/modules/hal/cirrus-logic)"
osource "/opt/ncs/ncs-v2.7/modules/hal/cirrus-logic/Kconfig"
config ZEPHYR_CIRRUS_LOGIC_MODULE
	bool
	default y
endmenu
menu "openthread (/opt/ncs/ncs-v2.7/modules/lib/openthread)"
osource "$(ZEPHYR_OPENTHREAD_KCONFIG)"
config ZEPHYR_OPENTHREAD_MODULE
	bool
	default y
endmenu
menu "suit-generator (/opt/ncs/ncs-v2.7/modules/lib/suit-generator)"
osource "/opt/ncs/ncs-v2.7/modules/lib/suit-generator/ncs/Kconfig"
config ZEPHYR_SUIT_GENERATOR_MODULE
	bool
	default y
endmenu
menu "suit-processor (/opt/ncs/ncs-v2.7/modules/lib/suit-processor)"
osource "/opt/ncs/ncs-v2.7/modules/lib/suit-processor/Kconfig"
config ZEPHYR_SUIT_PROCESSOR_MODULE
	bool
	default y
endmenu
menu "memfault-firmware-sdk (/opt/ncs/ncs-v2.7/modules/lib/memfault-firmware-sdk)"
osource "/opt/ncs/ncs-v2.7/modules/lib/memfault-firmware-sdk/ports/zephyr/Kconfig"
config ZEPHYR_MEMFAULT_FIRMWARE_SDK_MODULE
	bool
	default y
endmenu
menu "coremark (/opt/ncs/ncs-v2.7/modules/benchmark/coremark)"
osource "$(ZEPHYR_COREMARK_KCONFIG)"
config ZEPHYR_COREMARK_MODULE
	bool
	default y
endmenu
menu "canopennode (/opt/ncs/ncs-v2.7/modules/lib/canopennode)"
osource "$(ZEPHYR_CANOPENNODE_KCONFIG)"
config ZEPHYR_CANOPENNODE_MODULE
	bool
	default y
endmenu
menu "chre (/opt/ncs/ncs-v2.7/modules/lib/chre)"
osource "/opt/ncs/ncs-v2.7/modules/lib/chre/platform/zephyr/Kconfig"
config ZEPHYR_CHRE_MODULE
	bool
	default y
endmenu
menu "lz4 (/opt/ncs/ncs-v2.7/modules/lib/lz4)"
osource "$(ZEPHYR_LZ4_KCONFIG)"
config ZEPHYR_LZ4_MODULE
	bool
	default y
endmenu
menu "nanopb (/opt/ncs/ncs-v2.7/modules/lib/nanopb)"
osource "$(ZEPHYR_NANOPB_KCONFIG)"
config ZEPHYR_NANOPB_MODULE
	bool
	default y
endmenu
config ZEPHYR_TF_M_TESTS_MODULE
   bool
   default y
menu "zscilib (/opt/ncs/ncs-v2.7/modules/lib/zscilib)"
osource "/opt/ncs/ncs-v2.7/modules/lib/zscilib/Kconfig.zscilib"
config ZEPHYR_ZSCILIB_MODULE
	bool
	default y
endmenu
menu "cmsis (/opt/ncs/ncs-v2.7/modules/hal/cmsis)"
osource "$(ZEPHYR_CMSIS_KCONFIG)"
config ZEPHYR_CMSIS_MODULE
	bool
	default y
endmenu
menu "cmsis-dsp (/opt/ncs/ncs-v2.7/modules/lib/cmsis-dsp)"
osource "$(ZEPHYR_CMSIS_DSP_KCONFIG)"
config ZEPHYR_CMSIS_DSP_MODULE
	bool
	default y
endmenu
menu "cmsis-nn (/opt/ncs/ncs-v2.7/modules/lib/cmsis-nn)"
osource "$(ZEPHYR_CMSIS_NN_KCONFIG)"
config ZEPHYR_CMSIS_NN_MODULE
	bool
	default y
endmenu
menu "fatfs (/opt/ncs/ncs-v2.7/modules/fs/fatfs)"
osource "$(ZEPHYR_FATFS_KCONFIG)"
config ZEPHYR_FATFS_MODULE
	bool
	default y
endmenu
menu "hal_nordic (/opt/ncs/ncs-v2.7/modules/hal/nordic)"
osource "$(ZEPHYR_HAL_NORDIC_KCONFIG)"
config ZEPHYR_HAL_NORDIC_MODULE
	bool
	default y
endmenu
menu "hal_st (/opt/ncs/ncs-v2.7/modules/hal/st)"
osource "$(ZEPHYR_HAL_ST_KCONFIG)"
config ZEPHYR_HAL_ST_MODULE
	bool
	default y
endmenu
config ZEPHYR_HAL_WURTHELEKTRONIK_MODULE
   bool
   default y
config ZEPHYR_LIBMETAL_MODULE
   bool
   default y
menu "liblc3 (/opt/ncs/ncs-v2.7/modules/lib/liblc3)"
osource "$(ZEPHYR_LIBLC3_KCONFIG)"
config ZEPHYR_LIBLC3_MODULE
	bool
	default y
endmenu
menu "littlefs (/opt/ncs/ncs-v2.7/modules/fs/littlefs)"
osource "$(ZEPHYR_LITTLEFS_KCONFIG)"
config ZEPHYR_LITTLEFS_MODULE
	bool
	default y
endmenu
menu "loramac-node (/opt/ncs/ncs-v2.7/modules/lib/loramac-node)"
osource "$(ZEPHYR_LORAMAC_NODE_KCONFIG)"
config ZEPHYR_LORAMAC_NODE_MODULE
	bool
	default y
endmenu
menu "lvgl (/opt/ncs/ncs-v2.7/modules/lib/gui/lvgl)"
osource "/opt/ncs/ncs-v2.7/modules/lib/gui/lvgl/Kconfig"
config ZEPHYR_LVGL_MODULE
	bool
	default y
endmenu
config ZEPHYR_MIPI_SYS_T_MODULE
   bool
   default y
config ZEPHYR_NRF_HW_MODELS_MODULE
   bool
   default y
config ZEPHYR_OPEN_AMP_MODULE
   bool
   default y
menu "picolibc (/opt/ncs/ncs-v2.7/modules/lib/picolibc)"
osource "/opt/ncs/ncs-v2.7/modules/lib/picolibc/zephyr/Kconfig"
config ZEPHYR_PICOLIBC_MODULE
	bool
	default y
endmenu
menu "segger (/opt/ncs/ncs-v2.7/modules/debug/segger)"
osource "$(ZEPHYR_SEGGER_KCONFIG)"
config ZEPHYR_SEGGER_MODULE
	bool
	default y
endmenu
config ZEPHYR_TINYCRYPT_MODULE
   bool
   default y
menu "uoscore-uedhoc (/opt/ncs/ncs-v2.7/modules/lib/uoscore-uedhoc)"
osource "$(ZEPHYR_UOSCORE_UEDHOC_KCONFIG)"
config ZEPHYR_UOSCORE_UEDHOC_MODULE
	bool
	default y
endmenu
menu "zcbor (/opt/ncs/ncs-v2.7/modules/lib/zcbor)"
osource "$(ZEPHYR_ZCBOR_KCONFIG)"
config ZEPHYR_ZCBOR_MODULE
	bool
	default y
endmenu
menu "nrfxlib (/opt/ncs/ncs-v2.7/nrfxlib)"
osource "/opt/ncs/ncs-v2.7/nrfxlib/Kconfig.nrfxlib"
config ZEPHYR_NRFXLIB_MODULE
	bool
	default y
endmenu
menu "connectedhomeip (/opt/ncs/ncs-v2.7/modules/lib/matter)"
osource "/opt/ncs/ncs-v2.7/modules/lib/matter/config/nrfconnect/chip-module/Kconfig"
config ZEPHYR_CONNECTEDHOMEIP_MODULE
	bool
	default y
endmenu
```

## central/build/Kconfig/soc/Kconfig
```kconfig
# Load Zephyr SoC Kconfig descriptions.
osource "/opt/ncs/ncs-v2.7/zephyr/soc/xlnx/zynqmp/Kconfig"
osource "/opt/ncs/ncs-v2.7/zephyr/soc/xlnx/zynq7000/Kconfig"
osource "/opt/ncs/ncs-v2.7/zephyr/soc/xen/Kconfig"
osource "/opt/ncs/ncs-v2.7/zephyr/soc/ti/simplelink/Kconfig"
osource "/opt/ncs/ncs-v2.7/zephyr/soc/ti/lm3s6965/Kconfig"
osource "/opt/ncs/ncs-v2.7/zephyr/soc/ti/k3/Kconfig"
osource "/opt/ncs/ncs-v2.7/zephyr/soc/telink/tlsr/Kconfig"
osource "/opt/ncs/ncs-v2.7/zephyr/soc/starfive/jh71xx/Kconfig"
osource "/opt/ncs/ncs-v2.7/zephyr/soc/st/stm32/Kconfig"
osource "/opt/ncs/ncs-v2.7/zephyr/soc/snps/qemu_arc/Kconfig"
osource "/opt/ncs/ncs-v2.7/zephyr/soc/snps/nsim/Kconfig"
osource "/opt/ncs/ncs-v2.7/zephyr/soc/snps/hsdk4xd/Kconfig"
osource "/opt/ncs/ncs-v2.7/zephyr/soc/snps/hsdk/Kconfig"
osource "/opt/ncs/ncs-v2.7/zephyr/soc/snps/emsk/Kconfig"
osource "/opt/ncs/ncs-v2.7/zephyr/soc/snps/emsdp/Kconfig"
osource "/opt/ncs/ncs-v2.7/zephyr/soc/snps/arc_iot/Kconfig"
osource "/opt/ncs/ncs-v2.7/zephyr/soc/silabs/Kconfig"
osource "/opt/ncs/ncs-v2.7/zephyr/soc/sifive/sifive_freedom/Kconfig"
osource "/opt/ncs/ncs-v2.7/zephyr/soc/rockchip/Kconfig"
osource "/opt/ncs/ncs-v2.7/zephyr/soc/renode/riscv_virtual/Kconfig"
osource "/opt/ncs/ncs-v2.7/zephyr/soc/renesas/smartbond/Kconfig"
osource "/opt/ncs/ncs-v2.7/zephyr/soc/renesas/rzt2m/Kconfig"
osource "/opt/ncs/ncs-v2.7/zephyr/soc/renesas/rcar/Kconfig"
osource "/opt/ncs/ncs-v2.7/zephyr/soc/renesas/ra/Kconfig"
osource "/opt/ncs/ncs-v2.7/zephyr/soc/raspberrypi/Kconfig"
osource "/opt/ncs/ncs-v2.7/zephyr/soc/quicklogic/eos_s3/Kconfig"
osource "/opt/ncs/ncs-v2.7/zephyr/soc/qemu/virt_riscv/Kconfig"
osource "/opt/ncs/ncs-v2.7/zephyr/soc/qemu/malta/Kconfig"
osource "/opt/ncs/ncs-v2.7/zephyr/soc/openisa/rv32m1/Kconfig"
osource "/opt/ncs/ncs-v2.7/zephyr/soc/nxp/s32/Kconfig"
osource "/opt/ncs/ncs-v2.7/zephyr/soc/nxp/rw/Kconfig"
osource "/opt/ncs/ncs-v2.7/zephyr/soc/nxp/mcx/Kconfig"
osource "/opt/ncs/ncs-v2.7/zephyr/soc/nxp/lpc/Kconfig"
osource "/opt/ncs/ncs-v2.7/zephyr/soc/nxp/layerscape/Kconfig"
osource "/opt/ncs/ncs-v2.7/zephyr/soc/nxp/kinetis/Kconfig"
osource "/opt/ncs/ncs-v2.7/zephyr/soc/nxp/imxrt/Kconfig"
osource "/opt/ncs/ncs-v2.7/zephyr/soc/nxp/imx/Kconfig"
osource "/opt/ncs/ncs-v2.7/zephyr/soc/nuvoton/numicro/Kconfig"
osource "/opt/ncs/ncs-v2.7/zephyr/soc/nuvoton/numaker/Kconfig"
osource "/opt/ncs/ncs-v2.7/zephyr/soc/nuvoton/npcx/Kconfig"
osource "/opt/ncs/ncs-v2.7/zephyr/soc/nordic/Kconfig"
osource "/opt/ncs/ncs-v2.7/zephyr/soc/neorv32/Kconfig"
osource "/opt/ncs/ncs-v2.7/zephyr/soc/native/inf_clock/Kconfig"
osource "/opt/ncs/ncs-v2.7/zephyr/soc/microchip/miv/Kconfig"
osource "/opt/ncs/ncs-v2.7/zephyr/soc/microchip/mec/Kconfig"
osource "/opt/ncs/ncs-v2.7/zephyr/soc/lowrisc/opentitan/Kconfig"
osource "/opt/ncs/ncs-v2.7/zephyr/soc/litex/litex_vexriscv/Kconfig"
osource "/opt/ncs/ncs-v2.7/zephyr/soc/ite/ec/Kconfig"
osource "/opt/ncs/ncs-v2.7/zephyr/soc/intel/raptor_lake/Kconfig"
osource "/opt/ncs/ncs-v2.7/zephyr/soc/intel/lakemont/Kconfig"
osource "/opt/ncs/ncs-v2.7/zephyr/soc/intel/intel_socfpga_std/Kconfig"
osource "/opt/ncs/ncs-v2.7/zephyr/soc/intel/intel_socfpga/Kconfig"
osource "/opt/ncs/ncs-v2.7/zephyr/soc/intel/intel_niosv/Kconfig"
osource "/opt/ncs/ncs-v2.7/zephyr/soc/intel/intel_ish/Kconfig"
osource "/opt/ncs/ncs-v2.7/zephyr/soc/intel/intel_adsp/Kconfig"
osource "/opt/ncs/ncs-v2.7/zephyr/soc/intel/elkhart_lake/Kconfig"
osource "/opt/ncs/ncs-v2.7/zephyr/soc/intel/atom/Kconfig"
osource "/opt/ncs/ncs-v2.7/zephyr/soc/intel/apollo_lake/Kconfig"
osource "/opt/ncs/ncs-v2.7/zephyr/soc/intel/alder_lake/Kconfig"
osource "/opt/ncs/ncs-v2.7/zephyr/soc/infineon/cat3/Kconfig"
osource "/opt/ncs/ncs-v2.7/zephyr/soc/infineon/cat1a/Kconfig"
osource "/opt/ncs/ncs-v2.7/zephyr/soc/gd/gd32/Kconfig"
osource "/opt/ncs/ncs-v2.7/zephyr/soc/gaisler/leon3/Kconfig"
osource "/opt/ncs/ncs-v2.7/zephyr/soc/gaisler/gr716a/Kconfig"
osource "/opt/ncs/ncs-v2.7/zephyr/soc/espressif/Kconfig"
osource "/opt/ncs/ncs-v2.7/zephyr/soc/ene/kb1200/Kconfig"
osource "/opt/ncs/ncs-v2.7/zephyr/soc/efinix/sapphire/Kconfig"
osource "/opt/ncs/ncs-v2.7/zephyr/soc/cdns/xtensa_sample_controller/Kconfig"
osource "/opt/ncs/ncs-v2.7/zephyr/soc/cdns/dc233c/Kconfig"
osource "/opt/ncs/ncs-v2.7/zephyr/soc/brcm/bcmvk/Kconfig"
osource "/opt/ncs/ncs-v2.7/zephyr/soc/brcm/bcm2712/Kconfig"
osource "/opt/ncs/ncs-v2.7/zephyr/soc/brcm/bcm2711/Kconfig"
osource "/opt/ncs/ncs-v2.7/zephyr/soc/atmel/sam0/Kconfig"
osource "/opt/ncs/ncs-v2.7/zephyr/soc/atmel/sam/Kconfig"
osource "/opt/ncs/ncs-v2.7/zephyr/soc/aspeed/Kconfig"
osource "/opt/ncs/ncs-v2.7/zephyr/soc/arm/Kconfig"
osource "/opt/ncs/ncs-v2.7/zephyr/soc/arm/beetle/Kconfig"
osource "/opt/ncs/ncs-v2.7/zephyr/soc/andestech/Kconfig"
osource "/opt/ncs/ncs-v2.7/zephyr/soc/ambiq/Kconfig"
osource "/opt/ncs/ncs-v2.7/zephyr/soc/altr/zephyr_nios2f/Kconfig"
osource "/opt/ncs/ncs-v2.7/zephyr/soc/altr/qemu_nios2/Kconfig"
```

## peripheral/build/Kconfig/arch/Kconfig
```kconfig
# Load arch Kconfig descriptions.
osource "/opt/ncs/ncs-v2.7/zephyr/arch/x86/Kconfig"
osource "/opt/ncs/ncs-v2.7/zephyr/arch/xtensa/Kconfig"
osource "/opt/ncs/ncs-v2.7/zephyr/arch/sparc/Kconfig"
osource "/opt/ncs/ncs-v2.7/zephyr/arch/riscv/Kconfig"
osource "/opt/ncs/ncs-v2.7/zephyr/arch/posix/Kconfig"
osource "/opt/ncs/ncs-v2.7/zephyr/arch/nios2/Kconfig"
osource "/opt/ncs/ncs-v2.7/zephyr/arch/mips/Kconfig"
osource "/opt/ncs/ncs-v2.7/zephyr/arch/arm64/Kconfig"
osource "/opt/ncs/ncs-v2.7/zephyr/arch/arm/Kconfig"
osource "/opt/ncs/ncs-v2.7/zephyr/arch/arc/Kconfig"
```
