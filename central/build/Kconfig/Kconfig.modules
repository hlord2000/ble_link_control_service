## peripheral/build/Kconfig/soc/Kconfig.defconfig
```kconfig
# Load Zephyr SoC Kconfig defconfig.
osource "/opt/ncs/ncs-v2.7/zephyr/soc/xlnx/zynqmp/Kconfig.defconfig"
osource "/opt/ncs/ncs-v2.7/zephyr/soc/xlnx/zynq7000/Kconfig.defconfig"
osource "/opt/ncs/ncs-v2.7/zephyr/soc/xen/Kconfig.defconfig"
osource "/opt/ncs/ncs-v2.7/zephyr/soc/ti/simplelink/Kconfig.defconfig"
osource "/opt/ncs/ncs-v2.7/zephyr/soc/ti/lm3s6965/Kconfig.defconfig"
osource "/opt/ncs/ncs-v2.7/zephyr/soc/ti/k3/Kconfig.defconfig"
osource "/opt/ncs/ncs-v2.7/zephyr/soc/telink/tlsr/Kconfig.defconfig"
osource "/opt/ncs/ncs-v2.7/zephyr/soc/starfive/jh71xx/Kconfig.defconfig"
osource "/opt/ncs/ncs-v2.7/zephyr/soc/st/stm32/Kconfig.defconfig"
osource "/opt/ncs/ncs-v2.7/zephyr/soc/snps/qemu_arc/Kconfig.defconfig"
osource "/opt/ncs/ncs-v2.7/zephyr/soc/snps/nsim/Kconfig.defconfig"
osource "/opt/ncs/ncs-v2.7/zephyr/soc/snps/hsdk4xd/Kconfig.defconfig"
osource "/opt/ncs/ncs-v2.7/zephyr/soc/snps/hsdk/Kconfig.defconfig"
osource "/opt/ncs/ncs-v2.7/zephyr/soc/snps/emsk/Kconfig.defconfig"
osource "/opt/ncs/ncs-v2.7/zephyr/soc/snps/emsdp/Kconfig.defconfig"
osource "/opt/ncs/ncs-v2.7/zephyr/soc/snps/arc_iot/Kconfig.defconfig"
osource "/opt/ncs/ncs-v2.7/zephyr/soc/silabs/Kconfig.defconfig"
osource "/opt/ncs/ncs-v2.7/zephyr/soc/sifive/sifive_freedom/Kconfig.defconfig"
osource "/opt/ncs/ncs-v2.7/zephyr/soc/rockchip/Kconfig.defconfig"
osource "/opt/ncs/ncs-v2.7/zephyr/soc/renode/riscv_virtual/Kconfig.defconfig"
osource "/opt/ncs/ncs-v2.7/zephyr/soc/renesas/smartbond/Kconfig.defconfig"
osource "/opt/ncs/ncs-v2.7/zephyr/soc/renesas/rzt2m/Kconfig.defconfig"
osource "/opt/ncs/ncs-v2.7/zephyr/soc/renesas/rcar/Kconfig.defconfig"
osource "/opt/ncs/ncs-v2.7/zephyr/soc/renesas/ra/Kconfig.defconfig"
osource "/opt/ncs/ncs-v2.7/zephyr/soc/raspberrypi/Kconfig.defconfig"
osource "/opt/ncs/ncs-v2.7/zephyr/soc/quicklogic/eos_s3/Kconfig.defconfig"
osource "/opt/ncs/ncs-v2.7/zephyr/soc/qemu/virt_riscv/Kconfig.defconfig"
osource "/opt/ncs/ncs-v2.7/zephyr/soc/qemu/malta/Kconfig.defconfig"
osource "/opt/ncs/ncs-v2.7/zephyr/soc/openisa/rv32m1/Kconfig.defconfig"
osource "/opt/ncs/ncs-v2.7/zephyr/soc/nxp/s32/Kconfig.defconfig"
osource "/opt/ncs/ncs-v2.7/zephyr/soc/nxp/rw/Kconfig.defconfig"
osource "/opt/ncs/ncs-v2.7/zephyr/soc/nxp/mcx/Kconfig.defconfig"
osource "/opt/ncs/ncs-v2.7/zephyr/soc/nxp/lpc/Kconfig.defconfig"
osource "/opt/ncs/ncs-v2.7/zephyr/soc/nxp/layerscape/Kconfig.defconfig"
osource "/opt/ncs/ncs-v2.7/zephyr/soc/nxp/kinetis/Kconfig.defconfig"
osource "/opt/ncs/ncs-v2.7/zephyr/soc/nxp/imxrt/Kconfig.defconfig"
osource "/opt/ncs/ncs-v2.7/zephyr/soc/nxp/imx/Kconfig.defconfig"
osource "/opt/ncs/ncs-v2.7/zephyr/soc/nuvoton/numicro/Kconfig.defconfig"
osource "/opt/ncs/ncs-v2.7/zephyr/soc/nuvoton/numaker/Kconfig.defconfig"
osource "/opt/ncs/ncs-v2.7/zephyr/soc/nuvoton/npcx/Kconfig.defconfig"
osource "/opt/ncs/ncs-v2.7/zephyr/soc/nordic/Kconfig.defconfig"
osource "/opt/ncs/ncs-v2.7/zephyr/soc/neorv32/Kconfig.defconfig"
osource "/opt/ncs/ncs-v2.7/zephyr/soc/native/inf_clock/Kconfig.defconfig"
osource "/opt/ncs/ncs-v2.7/zephyr/soc/microchip/miv/Kconfig.defconfig"
osource "/opt/ncs/ncs-v2.7/zephyr/soc/microchip/mec/Kconfig.defconfig"
osource "/opt/ncs/ncs-v2.7/zephyr/soc/lowrisc/opentitan/Kconfig.defconfig"
osource "/opt/ncs/ncs-v2.7/zephyr/soc/litex/litex_vexriscv/Kconfig.defconfig"
osource "/opt/ncs/ncs-v2.7/zephyr/soc/ite/ec/Kconfig.defconfig"
osource "/opt/ncs/ncs-v2.7/zephyr/soc/intel/raptor_lake/Kconfig.defconfig"
osource "/opt/ncs/ncs-v2.7/zephyr/soc/intel/lakemont/Kconfig.defconfig"
osource "/opt/ncs/ncs-v2.7/zephyr/soc/intel/intel_socfpga_std/Kconfig.defconfig"
osource "/opt/ncs/ncs-v2.7/zephyr/soc/intel/intel_socfpga/Kconfig.defconfig"
osource "/opt/ncs/ncs-v2.7/zephyr/soc/intel/intel_niosv/Kconfig.defconfig"
osource "/opt/ncs/ncs-v2.7/zephyr/soc/intel/intel_ish/Kconfig.defconfig"
osource "/opt/ncs/ncs-v2.7/zephyr/soc/intel/intel_adsp/Kconfig.defconfig"
osource "/opt/ncs/ncs-v2.7/zephyr/soc/intel/elkhart_lake/Kconfig.defconfig"
osource "/opt/ncs/ncs-v2.7/zephyr/soc/intel/atom/Kconfig.defconfig"
osource "/opt/ncs/ncs-v2.7/zephyr/soc/intel/apollo_lake/Kconfig.defconfig"
osource "/opt/ncs/ncs-v2.7/zephyr/soc/intel/alder_lake/Kconfig.defconfig"
osource "/opt/ncs/ncs-v2.7/zephyr/soc/infineon/cat3/Kconfig.defconfig"
osource "/opt/ncs/ncs-v2.7/zephyr/soc/infineon/cat1a/Kconfig.defconfig"
osource "/opt/ncs/ncs-v2.7/zephyr/soc/gd/gd32/Kconfig.defconfig"
osource "/opt/ncs/ncs-v2.7/zephyr/soc/gaisler/leon3/Kconfig.defconfig"
osource "/opt/ncs/ncs-v2.7/zephyr/soc/gaisler/gr716a/Kconfig.defconfig"
osource "/opt/ncs/ncs-v2.7/zephyr/soc/espressif/Kconfig.defconfig"
osource "/opt/ncs/ncs-v2.7/zephyr/soc/ene/kb1200/Kconfig.defconfig"
osource "/opt/ncs/ncs-v2.7/zephyr/soc/efinix/sapphire/Kconfig.defconfig"
osource "/opt/ncs/ncs-v2.7/zephyr/soc/cdns/xtensa_sample_controller/Kconfig.defconfig"
osource "/opt/ncs/ncs-v2.7/zephyr/soc/cdns/dc233c/Kconfig.defconfig"
osource "/opt/ncs/ncs-v2.7/zephyr/soc/brcm/bcmvk/Kconfig.defconfig"
osource "/opt/ncs/ncs-v2.7/zephyr/soc/brcm/bcm2712/Kconfig.defconfig"
osource "/opt/ncs/ncs-v2.7/zephyr/soc/brcm/bcm2711/Kconfig.defconfig"
osource "/opt/ncs/ncs-v2.7/zephyr/soc/atmel/sam0/Kconfig.defconfig"
osource "/opt/ncs/ncs-v2.7/zephyr/soc/atmel/sam/Kconfig.defconfig"
osource "/opt/ncs/ncs-v2.7/zephyr/soc/aspeed/Kconfig.defconfig"
osource "/opt/ncs/ncs-v2.7/zephyr/soc/arm/Kconfig.defconfig"
osource "/opt/ncs/ncs-v2.7/zephyr/soc/arm/beetle/Kconfig.defconfig"
osource "/opt/ncs/ncs-v2.7/zephyr/soc/andestech/Kconfig.defconfig"
osource "/opt/ncs/ncs-v2.7/zephyr/soc/ambiq/Kconfig.defconfig"
osource "/opt/ncs/ncs-v2.7/zephyr/soc/altr/zephyr_nios2f/Kconfig.defconfig"
osource "/opt/ncs/ncs-v2.7/zephyr/soc/altr/qemu_nios2/Kconfig.defconfig"
```
